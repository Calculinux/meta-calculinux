## meta-calculinux-distro/conf/machine/qemu-arm32-test.conf
```bitbake
#@TYPE: Machine
#@NAME: QEMU ARM32 Test Machine
#@DESCRIPTION: Minimal ARM32 machine for testing calculinux-update on QEMU

require conf/machine/include/arm/armv7a/tune-cortexa9.inc

MACHINE_FEATURES = "ext4 serial"

KERNEL_IMAGETYPE = "zImage"
KERNEL_DEVICETREE = "vexpress-v2p-ca9.dtb"

SERIAL_CONSOLES = "115200;ttyAMA0"

# Use upstream kernel with ovl-restore patches
PREFERRED_PROVIDER_virtual/kernel = "linux-yocto-custom"
PREFERRED_VERSION_linux-yocto-custom = "6.1%"

# Minimal image size
IMAGE_FSTYPES = "ext4"
IMAGE_ROOTFS_SIZE ?= "512000"

# QEMU configuration
QB_SYSTEM_NAME = "qemu-system-arm"
QB_MACHINE = "-machine vexpress-a9"
QB_CPU = "-cpu cortex-a9"
QB_KERNEL_CMDLINE_APPEND = "console=ttyAMA0,115200"
QB_MEM = "-m 256"
QB_OPT_APPEND = "-nographic"

# Enable OverlayFS support
QB_DRIVE_TYPE = "/dev/mmcblk0"
QB_ROOTFS_OPT = "-drive id=disk0,file=@ROOTFS@,if=sd,format=raw"

# Disable features not needed for testing
MACHINE_FEATURES:remove = "alsa bluetooth wifi pcmcia irda usbgadget usbhost"

# OverlayFS data partition (label from WIC layout)
OVERLAYFS_ETC_MOUNT_POINT = "/data"
OVERLAYFS_ETC_DEVICE = "data"
OVERLAYFS_ETC_FSTYPE ?= "ext4"
OVERLAYFS_ETC_EXPOSE_LOWER = "1"
```

## meta-meshtastic/conf/layer.conf
```bitbake
BBPATH .= ":${LAYERDIR}"

BBFILES += "${LAYERDIR}/recipes-*/*/*.bb \
            ${LAYERDIR}/recipes-*/*/*.bbappend"

BBFILE_COLLECTIONS += "meta-meshtastic"
BBFILE_PATTERN_meta-meshtastic = "^${LAYERDIR}/"
BBFILE_PRIORITY_meta-meshtastic = "8"

LAYERDEPENDS_meta-meshtastic = "core"

LAYERSERIES_COMPAT_meta-meshtastic = "scarthgap walnascar"
```

## meta-picocalc-bsp-rockchip/conf/layer.conf
```bitbake
# We have a conf and classes directory, add to BBPATH
BBPATH .= ":${LAYERDIR}"

# We have recipes-* directories, add to BBFILES
BBFILES += "${LAYERDIR}/recipes-*/*/*.bb \
            ${LAYERDIR}/recipes-*/*/*.bbappend"

BBFILE_COLLECTIONS += "picocalc-bsp-rockchip"
BBFILE_PATTERN_picocalc-bsp-rockchip = "^${LAYERDIR}/"
BBFILE_PRIORITY_picocalc-bsp-rockchip = "99"


# OpenEmbedded compatibility information
# This should only be incremented on significant changes that will
# cause compatibility issues with other layers
LAYERVERSION_picocalc-bsp-rockchip = "1"

#LAYERDEPENDS_picocalc-bsp = "meta-raspberrypi"
LAYERSERIES_COMPAT_picocalc-bsp-rockchip = "scarthgap walnascar whinlatter"
```

## meta-picocalc-bsp-rockchip/recipes-kernel/linux/files/picocalc/Kconfig
```kconfig
menuconfig STAGING_PICOCALC
    bool "Picocalc staging drivers"
    default n
    depends on STAGING
    help
      This option enables the drivers necessary to support the Clockwork Pi PicoCalc.
      These drivers were originally developed by hisptoot (https://github.com/hisptoot/picocalc_luckfox_lyra).

if STAGING_PICOCALC

source "drivers/staging/picocalc/picocalc_mfd/Kconfig"
source "drivers/staging/picocalc/picocalc_mfd_bms/Kconfig"
source "drivers/staging/picocalc/picocalc_mfd_bkl/Kconfig"
source "drivers/staging/picocalc/picocalc_mfd_kbd/Kconfig"
source "drivers/staging/picocalc/picocalc_kbd/Kconfig"
source "drivers/staging/picocalc/picocalc_lcd/Kconfig"
source "drivers/staging/picocalc/picocalc_snd-pwm/Kconfig"
source "drivers/staging/picocalc/picocalc_snd-softpwm/Kconfig"

endif
```

## meta-picocalc-bsp-rockchip/recipes-kernel/linux/files/picocalc/picocalc_kbd/Kconfig
```kconfig
# SPDX-License-Identifier: GPL-2.0
config PICOCALC_KBD
	tristate "Picocalc Keyboard support"
	depends on I2C && INPUT
	help

	  Say Y or M here if you want to use the PicoCalc keyboard. The module will be called picocalc_kbd.
	  This is a legacy driver that has been replaced by PICOCALC_MFD and PICOCALC_MFD_KBD
```

## meta-picocalc-bsp-rockchip/recipes-kernel/linux/files/picocalc/picocalc_lcd/Kconfig
```kconfig
# SPDX-License-Identifier: GPL-2.0
config PICOCALC_LCD
    tristate "Picocalc screen support"
    help

      Say Y or M here if you want to use the PicoCalc lcd screen. The module will be called ili9488_fb.
```

## meta-picocalc-bsp-rockchip/recipes-kernel/linux/files/picocalc/picocalc_mfd/Kconfig
```kconfig
# SPDX-License-Identifier: GPL-2.0
config PICOCALC_MFD
	tristate "Picocalc MFD device support"
	depends on I2C && MFD_CORE
	imply PICOCALC_MFD_BMS
	imply PICOCALC_MFD_BKL
	imply PICOCALC_MFD_KBD
	help

	  Say Y or M here if you want to interface with PicoCalc hardware via the STM32 firmware. The module will be called picocalc_mfd.
```

## meta-picocalc-bsp-rockchip/recipes-kernel/linux/files/picocalc/picocalc_mfd_bkl/Kconfig
```kconfig
config PICOCALC_MFD_BKL
    tristate "PicoCalc MFD LCD Backlight Driver"
    depends on PICOCALC_MFD && BACKLIGHT_CLASS_DEVICE
    help
      Say Y or M here if you want to use the PicoCalc LCD Backlight. The module will be called picocalc_mfd_bkl.
```

## meta-picocalc-bsp-rockchip/recipes-kernel/linux/files/picocalc/picocalc_mfd_bms/Kconfig
```kconfig
config PICOCALC_MFD_BMS
    tristate "PicoCalc MFD BMS Driver"
    depends on PICOCALC_MFD && POWER_SUPPLY
    help
      Say Y or M here if you want to use the PicoCalc BMS. The module will be called picocalc_mfd_bms.
```

## meta-picocalc-bsp-rockchip/recipes-kernel/linux/files/picocalc/picocalc_mfd_kbd/Kconfig
```kconfig
# SPDX-License-Identifier: GPL-2.0
config PICOCALC_MFD_KBD
	tristate "Picocalc MFD: Keyboard support"
	depends on PICOCALC_MFD && INPUT
	help

	  Say Y or M here if you want to use the PicoCalc keyboard. The module will be called picocalc_mfd_kbd.
```

## meta-picocalc-bsp-rockchip/recipes-kernel/linux/files/picocalc/picocalc_mfd_led/Kconfig
```kconfig
config PICOCALC_MFD_LED
    tristate "PicoCalc MFD Keyboard Backlight Driver"
    depends on PICOCALC_MFD && LEDS_CLASS
    help
      Say Y or M here if you want to use the PicoCalc keyboard backlight. The module will be called picocalc_mfd_led.
```
