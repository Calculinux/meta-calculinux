## meta-calculinux-apps/conf/layer.conf
```bitbake
BBPATH =. "${LAYERDIR}:"

BBFILES += "${LAYERDIR}/recipes-*/*/*.bb \
            ${LAYERDIR}/recipes-*/*/*.bbappend"

BBFILE_COLLECTIONS += "meta-calculinux-apps"
BBFILE_PATTERN_meta-calculinux-apps = "^${LAYERDIR}/"
BBFILE_PRIORITY_meta-calculinux-apps = "10"

LAYERDEPENDS_meta-calculinux-apps = "core calculinux-distro meta-meshtastic scarthgap-rust-mixin"
LAYERSERIES_COMPAT_meta-calculinux-apps = "kirkstone langdale mickledore nanbield scarthgap styhead walnascar"
```

## meta-calculinux-distro/conf/distro/calculinux-distro.conf
```bitbake
require conf/distro/poky.conf
require conf/distro/include/gcsections.inc

# Ensure access to core recipe classes such as compress_doc
BBPATH:append = ":${COREBASE}/meta/classes-recipe"

# Required by BB_SIGNATURE_HANDLER = "OEEquivHash"
SSTATE_HASHEQUIV_METHOD ?= "oe.sstatesig.OEOuthashBasic"

DISTRO = "calculinux-distro"
DISTRO_NAME = "Calculinux PicoCalc Edition"
DISTROOVERRIDES = "poky:calculinux-distro"
TCLIBC = "musl"

# DISTRO_VERSION - Override Poky's version with Calculinux versioning
# We use = assignment which overrides Poky's = assignment (parsed earlier).
# Local builds get a sensible default with git hash.
# CI builds create kas-ci-override.yaml which adds local_conf_header entries
# that override this value (parsed last, so they win).
DISTRO_VERSION = "1.0.0-dev+${@bb.process.run('git -C ${TOPDIR}/../meta-calculinux rev-parse --short HEAD 2>/dev/null || echo unknown', shell=True)[0].strip()}"
# CI version patterns:
# - Tagged releases: DISTRO_VERSION = "v1.0.0-alpha4" (from git tag)
# - Main branch: DISTRO_VERSION = "1.0.0-continuous+<git-hash>"
# - Develop branch: DISTRO_VERSION = "1.0.0-develop+<git-hash>"

# We can use packagegroup-core-boot, but in the future we may need a new packagegroup-core-tiny
#POKY_DEFAULT_EXTRA_RDEPENDS += "packagegroup-core-boot"
# Drop kernel-module-af-packet from RRECOMMENDS
POKY_DEFAULT_EXTRA_RRECOMMENDS = ""

DISTRO_FEATURES += "ipv4 usbhost usbgadget wifi overlayfs rauc nls read-only-rootfs keyboard doc"

# Accept commercial license flags for multimedia software (e.g., ffmpeg)
LICENSE_FLAGS_ACCEPTED += "commercial"

# Enable automatic compression of manpages and info pages in all recipes
INHERIT_DISTRO:append = " compress_doc"

# Enable package management with opkg
PACKAGE_CLASSES = "package_ipk"

# Generate package index for opkg feeds
INHERIT += "package_ipk"

# Package feed configuration
# Feed structure:
# - ipk/{codename}/continuous/ - main branch continuous builds
# - ipk/{codename}/release/    - tagged releases
# - ipk/develop/continuous/    - develop branch builds
#
# CALCULINUX_FEED_SUBFOLDER can be overridden:
# - In local.conf for custom builds
# - In kas files for different build types
# - Defaults to "continuous" for normal builds
CALCULINUX_FEED_SUBFOLDER ??= "continuous"

# DISTRO_CODENAME - Defaults to "walnascar" (luckfox-lyra codename)
# For develop branch builds, override DISTRO_CODENAME to "develop"
# This can be done in kas-{machine}-develop.yaml or via local.conf
DISTRO_CODENAME ??= "walnascar"

PACKAGE_FEED_URIS = "https://opkg.calculinux.org/"
PACKAGE_FEED_BASE_PATHS = "ipk/${DISTRO_CODENAME}/${CALCULINUX_FEED_SUBFOLDER}"

DISTRO_FEATURES:class-native = "${DISTRO_FEATURES_DEFAULT} ${POKY_DEFAULT_DISTRO_FEATURES}"
DISTRO_FEATURES:class-nativesdk = "${DISTRO_FEATURES_DEFAULT} ${POKY_DEFAULT_DISTRO_FEATURES}"

# We try systemd to see how well it runs
DISTRO_FEATURES:append = " systemd usrmerge"
VIRTUAL-RUNTIME_init_manager = "systemd"
VIRTUAL-RUNTIME_initscripts = "systemd-compat-units"
# Disabling pulseaudio and sysvinit
DISTRO_FEATURES_BACKFILL_CONSIDERED += "pulseaudio sysvinit gobject-introspection-data ldconfig"
INIT_MANAGER ?= "systemd"
# POKY_INIT_MANAGER:poky-tiny = "mdev-busybox"

IMAGE_FSTYPES = "wic.gz tar.gz"

# Drop v86d from qemu dependency list (we support serial)
# Drop grub from meta-intel BSPs
# FIXME: A different mechanism is needed here. We could define -tiny
#        variants of all compatible machines, but that leads to a lot
#        more machine configs to maintain long term.
MACHINE_ESSENTIAL_EXTRA_RDEPENDS = ""

# The mtrace script included by eglibc is a perl script. This means the system
# will build perl in case this package is installed. Since we don't care about
# this script for the purposes of tiny, remove the dependency from here.
RDEPENDS:${PN}-mtrace:pn-eglibc = ""

# Disable python usage in opkg-utils since it won't build with tiny config
PACKAGECONFIG:remove:pn-opkg-utils = "python"

# Disable GTK GUI and sound for vim so we don't pull in an entire desktop stack
PACKAGECONFIG:remove:pn-vim = "gtkgui sound"

# Enable wifi for connman
# PACKAGECONFIG:pn-connman = "wispr client nftables wifi wpa-supplicant iwd"

# Disable meta-retro attempt to create user/groups
RETRO_USERADD_COMMAND = ""

# SDK Configuration - Include kernel headers and dev packages for all image contents
TOOLCHAIN_TARGET_TASK += "kernel-devsrc"
TOOLCHAIN_TARGET_TASK += "packagegroup-core-standalone-sdk-target"
# Limit linux-firmware to only USB WiFi adapters and other USB hardware
# License files from supported families are retained
# The main linux-firmware metapackage dependency is removed via bbappend

PACKAGE_EXCLUDE += " \
    linux-firmware-adsp-sst \
    linux-firmware-adsp-sst-license \
    linux-firmware-amdgpu \
    linux-firmware-amdgpu-aldebaran \
    linux-firmware-amdgpu-carrizo \
    linux-firmware-amdgpu-cezanne \
    linux-firmware-amdgpu-fiji \
    linux-firmware-amdgpu-hawaii \
    linux-firmware-amdgpu-license \
    linux-firmware-amdgpu-misc \
    linux-firmware-amdgpu-navi10 \
    linux-firmware-amdgpu-navi14 \
    linux-firmware-amdgpu-navi21 \
    linux-firmware-amdgpu-navi22 \
    linux-firmware-amdgpu-navi23 \
    linux-firmware-amdgpu-navi24 \
    linux-firmware-amdgpu-navi31 \
    linux-firmware-amdgpu-navi32 \
    linux-firmware-amdgpu-oland \
    linux-firmware-amdgpu-polaris10 \
    linux-firmware-amdgpu-polaris11 \
    linux-firmware-amdgpu-polaris12 \
    linux-firmware-amdgpu-raven \
    linux-firmware-amdgpu-rembrandt \
    linux-firmware-amdgpu-renoir \
    linux-firmware-amdgpu-stoney \
    linux-firmware-amdgpu-tonga \
    linux-firmware-amdgpu-topaz \
    linux-firmware-amdgpu-vega10 \
    linux-firmware-amdgpu-vega12 \
    linux-firmware-amlogic-vdec \
    linux-firmware-amlogic-vdec-license \
    linux-firmware-amphion-vpu \
    linux-firmware-amphion-vpu-license \
    linux-firmware-ar3k \
    linux-firmware-ar3k-license \
    linux-firmware-ath10k \
    linux-firmware-ath10k-license \
    linux-firmware-ath10k-misc \
    linux-firmware-ath10k-qca4019 \
    linux-firmware-ath10k-qca6174 \
    linux-firmware-ath10k-qca9377 \
    linux-firmware-ath10k-qca9887 \
    linux-firmware-ath10k-qca9888 \
    linux-firmware-ath10k-qca988x \
    linux-firmware-ath10k-qca9984 \
    linux-firmware-ath10k-qca99x0 \
    linux-firmware-ath10k-wcn3990 \
    linux-firmware-ath11k \
    linux-firmware-ath11k-ipq5018 \
    linux-firmware-ath11k-ipq6018 \
    linux-firmware-ath11k-ipq8074 \
    linux-firmware-ath11k-misc \
    linux-firmware-ath11k-qca2066 \
    linux-firmware-ath11k-qca6390 \
    linux-firmware-ath11k-qca6698aq \
    linux-firmware-ath11k-qcn9074 \
    linux-firmware-ath11k-wcn6750 \
    linux-firmware-ath11k-wcn6855 \
    linux-firmware-ath12k \
    linux-firmware-ath12k-misc \
    linux-firmware-ath12k-qcn9274 \
    linux-firmware-ath12k-wcn7850 \
    linux-firmware-ath3k \
    linux-firmware-bcm43143 \
    linux-firmware-bcm43236b \
    linux-firmware-bcm43241b0 \
    linux-firmware-bcm43241b4 \
    linux-firmware-bcm43241b5 \
    linux-firmware-bcm43242a \
    linux-firmware-bcm4329 \
    linux-firmware-bcm4329-fullmac \
    linux-firmware-bcm4330 \
    linux-firmware-bcm4334 \
    linux-firmware-bcm43340 \
    linux-firmware-bcm4335 \
    linux-firmware-bcm43362 \
    linux-firmware-bcm4339 \
    linux-firmware-bcm43430a0 \
    linux-firmware-bcm4350 \
    linux-firmware-bcm4350c2 \
    linux-firmware-bcm4354 \
    linux-firmware-bcm4356 \
    linux-firmware-bcm4356-pcie \
    linux-firmware-bcm43569 \
    linux-firmware-bcm43570 \
    linux-firmware-bcm4358 \
    linux-firmware-bcm43602 \
    linux-firmware-bcm4366b \
    linux-firmware-bcm4366c \
    linux-firmware-bcm4371 \
    linux-firmware-bcm4373 \
    linux-firmware-bcm43xx-hdr \
    linux-firmware-bnx2 \
    linux-firmware-bnx2x \
    linux-firmware-carl9170 \
    linux-firmware-cc33xx \
    linux-firmware-cnm \
    linux-firmware-cnm-license \
    linux-firmware-cw1200 \
    linux-firmware-cw1200-license \
    linux-firmware-i915 \
    linux-firmware-i915-license \
    linux-firmware-ibt \
    linux-firmware-ibt-11-5 \
    linux-firmware-ibt-12-16 \
    linux-firmware-ibt-17 \
    linux-firmware-ibt-18 \
    linux-firmware-ibt-20 \
    linux-firmware-ibt-hw-37-7 \
    linux-firmware-ibt-hw-37-8 \
    linux-firmware-ibt-license \
    linux-firmware-ibt-misc \
    linux-firmware-ice-enhanced \
    linux-firmware-ice-enhanced-license \
    linux-firmware-imx-sdma-imx6q \
    linux-firmware-imx-sdma-imx7d \
    linux-firmware-imx-sdma-license \
    linux-firmware-iwlwifi \
    linux-firmware-iwlwifi-135-6 \
    linux-firmware-iwlwifi-3160-17 \
    linux-firmware-iwlwifi-6000-4 \
    linux-firmware-iwlwifi-6000g2a-6 \
    linux-firmware-iwlwifi-6000g2b-6 \
    linux-firmware-iwlwifi-6050-5 \
    linux-firmware-iwlwifi-7260 \
    linux-firmware-iwlwifi-7265 \
    linux-firmware-iwlwifi-7265d \
    linux-firmware-iwlwifi-8000c \
    linux-firmware-iwlwifi-8265 \
    linux-firmware-iwlwifi-9000 \
    linux-firmware-iwlwifi-9260 \
    linux-firmware-iwlwifi-license \
    linux-firmware-iwlwifi-misc \
    linux-firmware-liquidio \
    linux-firmware-lt9611uxc \
    linux-firmware-mali-csffw-arch108 \
    linux-firmware-mali-csffw-license \
    linux-firmware-mediatek \
    linux-firmware-mediatek-license \
    linux-firmware-mellanox \
    linux-firmware-microchip \
    linux-firmware-microchip-license \
    linux-firmware-moxa \
    linux-firmware-moxa-license \
    linux-firmware-netronome \
    linux-firmware-netronome-license \
    linux-firmware-nvidia-gpu \
    linux-firmware-nvidia-license \
    linux-firmware-nvidia-tegra \
    linux-firmware-nvidia-tegra-k1 \
    linux-firmware-nxp8987-sdio \
    linux-firmware-nxp8997-sdio \
    linux-firmware-nxp9098-sdio \
    linux-firmware-nxpiw416-sdio \
    linux-firmware-nxpiw612-sdio \
    linux-firmware-olpc \
    linux-firmware-olpc-license \
    linux-firmware-phanfw \
    linux-firmware-phanfw-license \
    linux-firmware-powervr \
    linux-firmware-powervr-license \
    linux-firmware-prestera \
    linux-firmware-qat \
    linux-firmware-qat-license \
    linux-firmware-qca-qca61x4-serial \
    linux-firmware-qca-qca61x4-usb \
    linux-firmware-qca-qca2066 \
    linux-firmware-qca-qca6390 \
    linux-firmware-qca-qca6698 \
    linux-firmware-qca-wcn3950 \
    linux-firmware-qca-wcn3988 \
    linux-firmware-qca-wcn399x \
    linux-firmware-qca-wcn6750 \
    linux-firmware-qca-wcn7850 \
    linux-firmware-qcom-2-license \
    linux-firmware-qcom-adreno-a2xx \
    linux-firmware-qcom-adreno-a3xx \
    linux-firmware-qcom-adreno-a4xx \
    linux-firmware-qcom-adreno-a530 \
    linux-firmware-qcom-adreno-a623 \
    linux-firmware-qcom-adreno-a630 \
    linux-firmware-qcom-adreno-a650 \
    linux-firmware-qcom-adreno-a660 \
    linux-firmware-qcom-adreno-a663 \
    linux-firmware-qcom-adreno-a702 \
    linux-firmware-qcom-adreno-g750 \
    linux-firmware-qcom-aic100 \
    linux-firmware-qcom-apq8016-modem \
    linux-firmware-qcom-apq8016-wifi \
    linux-firmware-qcom-apq8096-adreno \
    linux-firmware-qcom-apq8096-audio \
    linux-firmware-qcom-apq8096-modem \
    linux-firmware-qcom-license \
    linux-firmware-qcom-qcm2290-adreno \
    linux-firmware-qcom-qcm2290-audio \
    linux-firmware-qcom-qcm2290-modem \
    linux-firmware-qcom-qcm2290-wifi \
    linux-firmware-qcom-qcm6490-adreno \
    linux-firmware-qcom-qcm6490-audio \
    linux-firmware-qcom-qcm6490-compute \
    linux-firmware-qcom-qcm6490-ipa \
    linux-firmware-qcom-qcm6490-wifi \
    linux-firmware-qcom-qcs615-adreno \
    linux-firmware-qcom-qcs8300-adreno \
    linux-firmware-qcom-qdu100 \
    linux-firmware-qcom-qrb4210-adreno \
    linux-firmware-qcom-qrb4210-audio \
    linux-firmware-qcom-qrb4210-compute \
    linux-firmware-qcom-qrb4210-modem \
    linux-firmware-qcom-qrb4210-wifi \
    linux-firmware-qcom-sa8775p-adreno \
    linux-firmware-qcom-sa8775p-audio \
    linux-firmware-qcom-sa8775p-compute \
    linux-firmware-qcom-sa8775p-generalpurpose \
    linux-firmware-qcom-sc8280xp-lenovo-x13s-adreno \
    linux-firmware-qcom-sc8280xp-lenovo-x13s-audio \
    linux-firmware-qcom-sc8280xp-lenovo-x13s-compute \
    linux-firmware-qcom-sc8280xp-lenovo-x13s-sensors \
    linux-firmware-qcom-sdm845-adreno \
    linux-firmware-qcom-sdm845-audio \
    linux-firmware-qcom-sdm845-compute \
    linux-firmware-qcom-sdm845-modem \
    linux-firmware-qcom-sdm845-thundercomm-db845c-sensors \
    linux-firmware-qcom-sm8250-adreno \
    linux-firmware-qcom-sm8250-audio \
    linux-firmware-qcom-sm8250-compute \
    linux-firmware-qcom-sm8250-thundercomm-rb5-sensors \
    linux-firmware-qcom-sm8550-audio-tplg \
    linux-firmware-qcom-sm8650-audio-tplg \
    linux-firmware-qcom-venus-1.8 \
    linux-firmware-qcom-venus-4.2 \
    linux-firmware-qcom-venus-5.2 \
    linux-firmware-qcom-venus-5.4 \
    linux-firmware-qcom-venus-6.0 \
    linux-firmware-qcom-vpu \
    linux-firmware-qcom-x1e80100-adreno \
    linux-firmware-qcom-x1e80100-audio \
    linux-firmware-qcom-x1e80100-lenovo-t14s-g6-adreno \
    linux-firmware-qcom-x1e80100-lenovo-t14s-g6-audio \
    linux-firmware-qcom-x1e80100-lenovo-t14s-g6-compute \
    linux-firmware-qcom-yamato-license \
    linux-firmware-qed \
    linux-firmware-qla2xxx \
    linux-firmware-qla2xxx-license \
    linux-firmware-radeon \
    linux-firmware-radeon-license \
    linux-firmware-rockchip-dptx \
    linux-firmware-rs9113 \
    linux-firmware-rs9116 \
    linux-firmware-sd8686 \
    linux-firmware-sd8688 \
    linux-firmware-sd8787 \
    linux-firmware-sd8797 \
    linux-firmware-sd8801 \
    linux-firmware-sd8887 \
    linux-firmware-sd8897 \
    linux-firmware-sd8997 \
    linux-firmware-ti-keystone \
    linux-firmware-ti-keystone-license \
    linux-firmware-usb8997 \
    linux-firmware-vt6656 \
    linux-firmware-vt6656-license \
    linux-firmware-wfx \
    linux-firmware-wfx-license \
    linux-firmware-wl12xx \
    linux-firmware-wl18xx \
    linux-firmware-xc4000 \
    linux-firmware-xc4000-license \
    linux-firmware-xc5000 \
    linux-firmware-xc5000-license \
    linux-firmware-xc5000c \
    linux-firmware-xc5000c-license \
"
```
